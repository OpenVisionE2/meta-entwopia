## conf/machine/bre2ze.conf
```bitbake
#
# This is config file for WWIO BRE2ZE
#

IMAGEDIR = "bre2ze"

MACHINE_ESSENTIAL_EXTRA_RDEPENDS += "\
    entwopia-dvb-modules-ew7362 \
    "

SOC_FAMILY = "bcm7362"

MACHINE_FEATURES += "ci 7segment textlcd"

PREFERRED_VERSION_linux-entwopia = "3.14.2"

require conf/machine/include/entwopia-oem.inc

DVBMEDIASINK_CONFIG = "--with-wma --with-wmv --with-pcm --with-dts --with-eac3"
```

## conf/machine/enfinity.conf
```bitbake
#
# This is config file for EVO ENfinity
#

IMAGEDIR = "enfinity"

MACHINE_ESSENTIAL_EXTRA_RDEPENDS += "\
    entwopia-dvb-modules-ew7358 \
    "

SOC_FAMILY = "bcm7358"

MACHINE_FEATURES += "singlecore 7segment textlcd"

PREFERRED_VERSION_linux-entwopia = "3.14.2"

require conf/machine/include/entwopia-oem.inc

DVBMEDIASINK_CONFIG = "--with-wma --with-wmv --with-pcm --with-dts --with-eac3"
```

## conf/machine/evomini.conf
```bitbake
#
# This is config file for EVO ENfinity mini
#

IMAGEDIR = "mini"

MACHINE_ESSENTIAL_EXTRA_RDEPENDS += "\
    entwopia-dvb-modules-ch62lc \
    "

SOC_FAMILY = "bcm7362"

PREFERRED_VERSION_linux-entwopia = "3.14.2"

require conf/machine/include/entwopia-oem.inc

DVBMEDIASINK_CONFIG = "--with-wma --with-wmv --with-pcm --with-dts --with-eac3"
```

## conf/machine/include/entwopia-oem.inc
```bitbake
# We know about rtc
MACHINE_FEATURES_BACKFILL_CONSIDERED += "rtc"

BOX_BRAND = "entwopia"

MTD_KERNEL = "mtd2"
MTD_ROOTFS = "mtd0"

KERNEL_FILE = "kernel.bin"
ROOTFS_FILE = "rootfs.bin"

DVBPROVIDER = "kernel"

MACHINE_ESSENTIAL_EXTRA_RRECOMMENDS += "\
    kernel-module-cdfs \
    "

MACHINE_EXTRA_RRECOMMENDS += "\
    gstreamer1.0-plugin-dvbmediasink \
    "

KERNEL_MODULE_AUTOLOAD += "xfs"

TARGET_ARCH = "mipsel"
DEFAULTTUNE = "mips32el"

GLIBC_EXTRA_OECONF = "--with-tls --with-__thread"

PREFERRED_PROVIDER_virtual/kernel = "linux-entwopia"

KERNEL_IMAGETYPE = "vmlinux"
KERNEL_OUTPUT = "${KERNEL_IMAGETYPE}"
KERNEL_CONSOLE = "ttyS0,115200n8"

IMAGE_FSTYPES ?= "ubi"

UBI_VOLNAME = "rootfs"
MKUBIFS_ARGS = "-m 2048 -e 126976 -c 4096"
UBINIZE_ARGS = "-m 2048 -p 128KiB"

IMAGE_CMD_ubi_prepend = "\
    rm -rf ${IMAGE_ROOTFS}/boot/*; \
    rm -rf ${IMAGE_ROOTFS}/tmp/*; \
    "

FORCE ?= "no"

IMAGE_CMD_ubi_append = "\
    mkdir -p ${DEPLOY_DIR_IMAGE}/${IMAGEDIR}; \
    mv ${IMGDEPLOYDIR}/${IMAGE_NAME}${IMAGE_NAME_SUFFIX}.ubi ${DEPLOY_DIR_IMAGE}/${IMAGEDIR}/rootfs.bin; \
    gzip -9c ${DEPLOY_DIR_IMAGE}/vmlinux-${MACHINE}.bin > ${DEPLOY_DIR_IMAGE}/${IMAGEDIR}/kernel.bin; \
    echo ${IMAGE_NAME} > ${DEPLOY_DIR_IMAGE}/${IMAGEDIR}/imageversion; \
    if [ "${FORCE}" = "yes" ]; then \
        echo "rename this file to 'noforce' to force an update with confirmation" > ${DEPLOY_DIR_IMAGE}/${IMAGEDIR}/force; \
    else \
        echo "rename this file to 'force' to force an update without confirmation" > ${DEPLOY_DIR_IMAGE}/${IMAGEDIR}/noforce; \
    fi; \
    rm -f ${DEPLOY_DIR_IMAGE}/*.zip; \
    cd ${DEPLOY_DIR_IMAGE}; \
    zip ${IMAGE_NAME}_usb.zip ${IMAGEDIR}/*; \
    rm -f ${DEPLOY_DIR_IMAGE}/*.ubi; \
    rm -f ${DEPLOY_DIR_IMAGE}/*.ubifs; \
    rm -Rf ${IMAGEDIR}; \
    "


MACHINE_FEATURES += "3dtv alsa hdmicec switchoff blindscan-tbs videoenhancement middleflash"

# Broken bootloader can only flash around 100 MB
FLASHSIZE = "96"

BOOTLOGO_FILENAME = "splash.bin"

require conf/machine/include/tune-mips32.inc
require conf/machine/include/soc-family.inc
```

## conf/machine/include/ew7358.inc
```bitbake
require conf/machine/include/entwopia-oem.inc

MACHINE_ESSENTIAL_EXTRA_RDEPENDS += "\
    entwopia-dvb-modules-ew7358 \
    "

SOC_FAMILY = "bcm7358"

MACHINE_FEATURES += "7segment textlcd RCA YUV"

PREFERRED_VERSION_linux-entwopia = "3.14.2"

DVBMEDIASINK_CONFIG = "--with-wma --with-wmv --with-pcm --with-dts --with-eac3"

STB_PLATFORM = "ew7358"
```

## conf/machine/marvel1.conf
```bitbake
#
# This is config file for VisionNet Marvel 1
#

require conf/machine/include/ew7358.inc

RCNAME = "visionnet"

DISPLAY_BRAND = "VisionNet"
DISPLAY_MODEL = "Marvel 1"
```

## conf/machine/viperslim.conf
```bitbake
#
# This is config file for Amiko Viper Slim
#

IMAGEDIR = "viperslim"

MACHINE_ESSENTIAL_EXTRA_RDEPENDS = "\
    entwopia-dvb-modules-yh73625 \
    "

SOC_FAMILY = "bcm73625"

MACHINE_FEATURES += "ci 7segment textlcd linuxwifi"

PREFERRED_VERSION_linux-entwopia = "4.10.6"

require conf/machine/include/entwopia-oem.inc

DVBSKYPROVIDER = "kernel"

DVBMEDIASINK_CONFIG = "--with-wma --with-wmv --with-pcm --with-dts --with-eac3 --with-h265 --with-vb6 --with-vb8 --with-spark"

FORCE = "yes"
```
